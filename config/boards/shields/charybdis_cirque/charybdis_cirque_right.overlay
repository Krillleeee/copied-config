#include "charybdis_cirque.dtsi"

&default_transform {
    col-offset = <6>;
};

&kscan0 {
    diode-direction = "col2row";
    col-gpios
        = <&pro_micro 10 (GPIO_ACTIVE_HIGH)> // COL0 
    ;
};
// &nice_nano_spi {
//     status = "okay";
// };
// &trackpad {
//     status = "okay";
// };


&pro_micro_spi {
	compatible = "nordic,nrf-spim";
    status = "okay";

    miso-pin = <17>; // P0.17
    mosi-pin = <20>; // P0.20
    sck-pin = <22>; // P0.22
    cs-gpios = <&gpio0 24 GPIO_ACTIVE_LOW>; // P0.24

    trackball: trackball@0 {
        compatible = "pixart,pmw33xx";
        reg = <0>;
        label = "Pixart PMW3360";
        cs-gpios = <&gpio0 6 GPIO_ACTIVE_LOW>; // P0.24
        motswk-gpios = <&gpio1 0 GPIO_ACTIVE_LOW>; // P1.00 = 32 + 0
        spi-max-frequency = <10000000>;
        cpi = <600>;
    };
};






